## conf/distro/sonomkr.conf
```bitbake
require conf/distro/poky.conf  

DISTRO = "sonomkr"
DISTRO_NAME = "SonoMKR (Raspberry Pi Distribution for the SonoMKR Project)"
DISTRO_VERSION = "2.1"
DISTRO_CODENAME = "krogoth"
SDK_VENDOR = "-sonomkrsdk"

MAINTAINER = "Valentin LE BESCOND <valentin.lebescond@sonomkr.fr>"

TARGET_VENDOR = "-sonomkr"

POKY_DEFAULT_DISTRO_FEATURES = "largefile opengl ptest multiarch"

DISTRO_FEATURES_append = " alsa ppp systemd"
VIRTUAL-RUNTIME_init_manager = "systemd"

EXTRA_IMAGE_FEATURES_append = " package-management"
PACKAGE_CLASSES ?= "package_rpm package_ipk"

IMAGE_FSTYPES_append = " rpi-sdimg"

ENABLE_SPI_BUS_raspberrypi2 = "1"
ENABLE_I2C_raspberrypi2 = "1"

PREFERRED_VERSION_linux-raspberrypi = "4.4%"
PREFERRED_VERSION_nodejs = "6%"

KERNEL_DEVICETREE_append = " overlays/sonomkr-card-overlay.dtb \
"
```

## conf/layer.conf
```bitbake
# We have a conf and classes directory, add to BBPATH
BBPATH .= ":${LAYERDIR}"

# We have recipes-* directories, add to BBFILES
BBFILES += "${LAYERDIR}/recipes-*/*/*.bb \
	${LAYERDIR}/recipes-*/*/*.bbappend"

BBFILE_COLLECTIONS += "tmp"
BBFILE_PATTERN_tmp = "^${LAYERDIR}/"
BBFILE_PRIORITY_tmp = "6"
```
